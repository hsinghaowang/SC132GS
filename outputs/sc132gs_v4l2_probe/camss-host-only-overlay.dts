/dts-v1/;
/plugin/;

/* Stage 1: enable only the upstream CAMSS host. No CCI or sensor node. */

&camss {
	status = "okay";
	/* Ubuntu's packaged QCS6490 DTB spells this as
	 * "power-domains-names". The CAMSS driver uses the standard
	 * "power-domain-names" property when attaching ife0..2/top.
	 */
	power-domain-names = "ife0", "ife1", "ife2", "top";
	/* The packaged DT calls this GCC clock "gcc_camera_ahb", while the
	 * Ubuntu 6.8.0-1084 SC7280 CAMSS resource table requests "cpas_ahb".
	 * Keep the clock specifier/order and correct only its consumer name.
	 */
	clock-names = "camnoc_axi",
		"csi0", "csi1", "csi2", "csi3", "csi4",
		"csiphy0", "csiphy0_timer",
		"csiphy1", "csiphy1_timer",
		"csiphy2", "csiphy2_timer",
		"csiphy3", "csiphy3_timer",
		"csiphy4", "csiphy4_timer",
		"cpas_ahb", "gcc_camera_axi", "soc_ahb",
		"vfe0_axi", "vfe0", "vfe0_cphy_rx",
		"vfe1_axi", "vfe1", "vfe1_cphy_rx",
		"vfe2_axi", "vfe2", "vfe2_cphy_rx",
		"vfe0_lite", "vfe0_lite_cphy_rx",
		"vfe1_lite", "vfe1_lite_cphy_rx";
	vdda-phy-supply = <&vreg_l10c_0p88>;
	vdda-pll-supply = <&vreg_l6b_1p2>;
};
